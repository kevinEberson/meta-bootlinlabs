## conf/machine/beaglebone_armv8.conf
```bitbake
# Setup hardware family
require conf/machine/include/ti-soc.inc
SOC_FAMILY:append = ":ti33x"

# Set default tune for armv8
DEFAULTTUNE = "cortexa8thf-neon"
require conf/machine/include/arm/armv7a/tune-cortexa8.inc

# Kernel configuration
PREFERRED_PROVIDER_virtual/kernel = "linux-ti-staging"
KERNEL_IMAGETYPE = "zImage"
KERNEL_DEVICETREE = "am335x-boneblack.dtb am335x-boneblack-wireless.dtb"

# U-boot configuration
PREFERRED_PROVIDER_virtual/bootloader = "u-boot-ti-staging"
UBOOT_MACHINE = "arm"
UBOOT_CONFIG = "am335x_evm_config"
UBOOT_ENTRYPOINT = "0x80008000"
UBOOT_LOADADDRESS = "0x80008000"

# Setup serial communication
SERIAL_CONSOLES = "115200;ttyS0"

# Enable some machine features
MACHINE_FEATURES = " \
	apm \
	usbgadget \
	usbhost \
	vfat \
	ext2 \
	alsa"
```
